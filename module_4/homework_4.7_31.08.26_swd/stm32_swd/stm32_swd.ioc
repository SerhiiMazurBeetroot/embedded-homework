# file: stm32_swd.ioc
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Mcu.Family=STM32F4
Mcu.Name=STM32F401C(B-C)Ux
Mcu.Package=UFQFPN48
NVIC.PriorityGroup=NVIC_PRIORITYGROUP_4
PA13.Mode=Serial_Wire
PA13.Signal=SYS_JTMS-SWDIO
PA14.Mode=Serial_Wire
PA14.Signal=SYS_JTCK-SWCLK
ProjectManager.HeapSize=0x200
ProjectManager.StackSize=0x400
ProjectManager.TargetToolchain=STM32CubeIDE
RCC.AHBFreq_Value=16000000
RCC.APB1Freq_Value=16000000
RCC.APB2Freq_Value=16000000
RCC.CortexFreq_Value=16000000
RCC.HSE_VALUE=25000000
RCC.HSI_VALUE=16000000
RCC.LSE_VALUE=32768
RCC.SYSCLKFreq_VALUE=16000000
RCC.VCOOutputFreq_Value=192000000
board=custom

// file: Core/Src/main.c
/* USER CODE BEGIN Header */
/**
  ******************************************************************************
  * @file           : main.c
  * @brief          : Main program body
  ******************************************************************************
  * @attention
  *
  * Copyright (c) 2026 STMicroelectronics.
  * All rights reserved.
  *
  * This software is licensed under terms that can be found in the LICENSE file
  * in the root directory of this software component.
  * If no LICENSE file comes with this software, it is provided AS-IS.
  *
  ******************************************************************************
  */
/* USER CODE END Header */
#include "main.h"

/* USER CODE BEGIN Includes */
#include "stm32f4xx.h"

/* USER CODE END Includes */

/* USER CODE BEGIN PD */
#define LED_PIN   13u
#define BTN_PIN   0u
/* USER CODE END PD */

/* USER CODE BEGIN PV */
static volatile uint32_t msTicks        = 0;
static volatile uint32_t lastToggle     = 0;
static volatile uint32_t lastButtonEdge = 0;

// Set of flashing periods (ms); the button cycles through them
static const uint32_t periods[] = { 100, 250, 500, 1000, 2000 };
static const uint8_t  periodsCount = sizeof(periods) / sizeof(periods[0]);
static volatile uint8_t periodIndex = 2; /* start — 500 ms */
/* USER CODE END PV */

void SystemClock_Config(void);

/* USER CODE BEGIN 0 */
// SysTick: 1 ms system timer, used as a "clock"
void SysTick_Handler(void)
{
    msTicks++;
}

// GPIO init
static void GPIO_Init(void)
{
    RCC->AHB1ENR |= RCC_AHB1ENR_GPIOCEN | RCC_AHB1ENR_GPIOAEN;

    // PC13 — output push-pull, low speed enough for the LED
    GPIOC->MODER   &= ~(0x3u << (LED_PIN * 2));
    GPIOC->MODER   |=  (0x1u << (LED_PIN * 2));   // 01 = General purpose output
    GPIOC->OTYPER  &= ~(0x1u << LED_PIN);         //  0  = push-pull
    GPIOC->OSPEEDR &= ~(0x3u << (LED_PIN * 2));   // low speed
    GPIOC->ODR     |=  (0x1u << LED_PIN);         // LED active-LOW -> off

    // PA0 — input with pull-up to VCC (button pulls the line to GND)
    GPIOA->MODER &= ~(0x3u << (BTN_PIN * 2)); // 00 = input
    GPIOA->PUPDR &= ~(0x3u << (BTN_PIN * 2));
    GPIOA->PUPDR |= (0x1u << (BTN_PIN * 2)); // 01 = pull-up
}

// EXTI0 init on PA0
static void EXTI_Init(void)
{
    RCC->APB2ENR |= RCC_APB2ENR_SYSCFGEN;

    // EXTI0 connect to port A (PA0)
    SYSCFG->EXTICR[0] &= ~(0xFu << 0);
    SYSCFG->EXTICR[0] |=  (0x0u << 0); // 0000 = PA0

    EXTI->IMR  |= (1u << BTN_PIN);   // allow interrupt on line 0
    EXTI->FTSR |= (1u << BTN_PIN);   // reaction to falling edge (press)
    EXTI->RTSR &= ~(1u << BTN_PIN);

    NVIC_SetPriority(EXTI0_IRQn, 1);
    NVIC_EnableIRQ(EXTI0_IRQn);
}

// Button interrupt handler
void EXTI0_IRQHandler(void)
{
    if (EXTI->PR & (1u << BTN_PIN))
    {
        EXTI->PR = (1u << BTN_PIN); // clear flag

        // software debounce — ignore repeated activations during 200 ms
        if ((msTicks - lastButtonEdge) > 200u)
        {
            lastButtonEdge = msTicks;
            periodIndex = (uint8_t)((periodIndex + 1u) % periodsCount);
        }
    }
}
/* USER CODE END 0 */

int main(void)
{
    SystemCoreClockUpdate();
    SysTick_Config(SystemCoreClock / 1000u); // SysTick tick every 1 ms

    GPIO_Init();
    EXTI_Init();

    while (1)
    {
        uint32_t currentPeriod = periods[periodIndex];

        if ((msTicks - lastToggle) >= currentPeriod)
        {
            lastToggle = msTicks;
            GPIOC->ODR ^= (1u << LED_PIN); // toggle LED
        }
    }
}

void SystemClock_Config(void)
{
  RCC_OscInitTypeDef RCC_OscInitStruct = {0};
  RCC_ClkInitTypeDef RCC_ClkInitStruct = {0};

  /** Configure the main internal regulator output voltage
  */
  __HAL_RCC_PWR_CLK_ENABLE();
  __HAL_PWR_VOLTAGESCALING_CONFIG(PWR_REGULATOR_VOLTAGE_SCALE2);

  /** Initializes the RCC Oscillators according to the specified parameters
  * in the RCC_OscInitTypeDef structure.
  */
  RCC_OscInitStruct.OscillatorType = RCC_OSCILLATORTYPE_HSI;
  RCC_OscInitStruct.HSIState = RCC_HSI_ON;
  RCC_OscInitStruct.HSICalibrationValue = RCC_HSICALIBRATION_DEFAULT;
  RCC_OscInitStruct.PLL.PLLState = RCC_PLL_NONE;
  if (HAL_RCC_OscConfig(&RCC_OscInitStruct) != HAL_OK)
  {
    Error_Handler();
  }

  /** Initializes the CPU, AHB and APB buses clocks
  */
  RCC_ClkInitStruct.ClockType = RCC_CLOCKTYPE_HCLK|RCC_CLOCKTYPE_SYSCLK
                              |RCC_CLOCKTYPE_PCLK1|RCC_CLOCKTYPE_PCLK2;
  RCC_ClkInitStruct.SYSCLKSource = RCC_SYSCLKSOURCE_HSI;
  RCC_ClkInitStruct.AHBCLKDivider = RCC_SYSCLK_DIV1;
  RCC_ClkInitStruct.APB1CLKDivider = RCC_HCLK_DIV1;
  RCC_ClkInitStruct.APB2CLKDivider = RCC_HCLK_DIV1;

  if (HAL_RCC_ClockConfig(&RCC_ClkInitStruct, FLASH_LATENCY_0) != HAL_OK)
  {
    Error_Handler();
  }
}

static void MX_GPIO_Init(void)
{

  /* GPIO Ports Clock Enable */
  __HAL_RCC_GPIOA_CLK_ENABLE();

}

void Error_Handler(void)
{
  __disable_irq();
  while (1)
  {
  }
}
